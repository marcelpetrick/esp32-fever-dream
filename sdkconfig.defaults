## sdkconfig.defaults
```kconfig
CONFIG_IDF_TARGET="esp32"
CONFIG_ESPTOOLPY_FLASHSIZE_4MB=y
CONFIG_ESPTOOLPY_FLASHMODE_DIO=y
CONFIG_ESPTOOLPY_FLASHFREQ_40M=y
CONFIG_SPIRAM=y
CONFIG_PARTITION_TABLE_CUSTOM=y
CONFIG_PARTITION_TABLE_CUSTOM_FILENAME="partitions.csv"
CONFIG_COMPILER_WARN_WRITE_STRINGS=y
CONFIG_COMPILER_STACK_CHECK_MODE_STRONG=y
CONFIG_ESP_TASK_WDT_EN=y
CONFIG_ESP_TASK_WDT_TIMEOUT_S=10
CONFIG_OV5640_SUPPORT=y
CONFIG_CAMERA_AF_SUPPORT=y
CONFIG_CAMERA_AF_DEFAULT_TIMEOUT_MS=2000
```
